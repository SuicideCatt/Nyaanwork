## Kconfig
```kconfig
rsource "src/Asset/Kconfig"
rsource "src/WindowSystem/Kconfig"
rsource "src/Input/Kconfig"
rsource "src/ImGUI/Kconfig"
rsource "src/HighOpenGL/Kconfig"

rsource "tests/Kconfig"
```

## cross/Kconfig.mingw
```kconfig
config NYAANWORK_CROSS_COMPILE_FROM_LINUX
	bool "Enable"
	default n

config NYAANWORK_CROSS_COMPILE_FROM_LINUX_LIBRARIES
	string "Path to libraries (.dll)"
	default ""

config NYAANWORK_CROSS_COMPILE_FROM_LINUX_WINE
	string "Path to wine (for run targets)"
	default "wine"

config NYAANWORK_CROSS_COMPILE_FROM_LINUX_WINE_PREFIX
	string "Path to wine prefix"
	default ""
```

## src/Asset/Kconfig
```kconfig
config NYAANWORK_ASSET
	bool "Enable Asset module"
	default y

config NYAANWORK_ASSET_IMAGE
	bool "Pixels, Colors, Image, ImageView"
	default y
	depends on NYAANWORK_ASSET

config NYAANWORK_ASSET_TILE
	bool "TileView, Tile, TileSet"
	default y
	depends on NYAANWORK_ASSET_IMAGE
```

## src/HighOpenGL/Core330/Kconfig
```kconfig
config NYAANWORK_HIGH_OPENGL_CORE330
	bool "Enable OpenGL 330 core context"
	default y
	depends on NYAANWORK_HIGH_OPENGL

config NYAANWORK_HIGH_OPENGL_CORE330_DYNAMIC_LIMITS
	bool "Enable dynamic limits"
	default n
	depends on NYAANWORK_HIGH_OPENGL_CORE330

# If your GPU have greater limits than current maximum please open issue or PR
# indluding logs of $build/Nyaanwork/Tests/HighOpenGL/*/init

config NYAANWORK_HIGH_OPENGL_CORE330_TEXTURE_SLOTS
	int "Texture slots limit"
	range 1 32 # max from AMD Radeon RX 6600
	default 16
	depends on NYAANWORK_HIGH_OPENGL_CORE330
	depends on !NYAANWORK_HIGH_OPENGL_CORE330_DYNAMIC_LIMITS

config NYAANWORK_HIGH_OPENGL_CORE330_TEXTURE_SIZE
	int "Texture size limit"
	range 1 65536 # max from AMD Radeon RX 9070 XT
	default 1024
	depends on NYAANWORK_HIGH_OPENGL_CORE330
	depends on !NYAANWORK_HIGH_OPENGL_CORE330_DYNAMIC_LIMITS

config NYAANWORK_HIGH_OPENGL_CORE330_UNIFORM_BUFFER_BINDINGS
	int "Uniform buffer bindings limit"
	range 1 120 # max from AMD Radeon RX 6600
	default 36
	depends on NYAANWORK_HIGH_OPENGL_CORE330
	depends on !NYAANWORK_HIGH_OPENGL_CORE330_DYNAMIC_LIMITS

config NYAANWORK_HIGH_OPENGL_CORE330_UNIFORM_BLOCK_SIZE
	int "Uniform block size limit (bytes)"
	range 1 2147483647 # max from AMD Radeon RX 6600
	default 16384
	depends on NYAANWORK_HIGH_OPENGL_CORE330
	depends on !NYAANWORK_HIGH_OPENGL_CORE330_DYNAMIC_LIMITS
```

## src/HighOpenGL/Kconfig
```kconfig
config NYAANWORK_HIGH_OPENGL
	bool "Enable HighOpenGL module"
	default y
	depends on NYAANWORK_WINDOW_SYSTEM_OPENGL && NYAANWORK_ASSET_IMAGE

rsource "Core330/Kconfig"
```

## src/ImGUI/Kconfig
```kconfig
config NYAANWORK_IMGUI
	bool "Enable ImGUI module"
	default n
	depends on NYAANWORK_WINDOW_SYSTEM
```

## src/Input/Kconfig
```kconfig
config NYAANWORK_INPUT
	bool "Enable Input module"
	default y
	depends on NYAANWORK_WINDOW_SYSTEM

config NYAANWORK_INPUT_COMBINATION_SIZE
	int "Key and buttons combination size"
	range 2 6
	default 4
	depends on NYAANWORK_INPUT

config NYAANWORK_INPUT_COMBINATIONS_COUNT
	int "Key and buttons combinations count"
	range 1 4
	default 2
	depends on NYAANWORK_INPUT
```

## src/WindowSystem/Kconfig
```kconfig
config NYAANWORK_WINDOW_SYSTEM
	bool "WindowSystem"
	default y

menu "WindowSystem"
	depends on NYAANWORK_WINDOW_SYSTEM

	config NYAANWORK_WINDOW_SYSTEM_OPENGL
		bool "OpenGL support"
		default y
	config NYAANWORK_WINDOW_SYSTEM_VULKAN
		bool "Vulkan support"
		default y

	menu "Backends"
		config NYAANWORK_WINDOW_SYSTEM_BACKENDS_LINUX
			bool "Linux backends support"
			default y

		config NYAANWORK_WINDOW_SYSTEM_BACKENDS_LINUX_XCB
			bool "XCB(X11)"
			default y
			depends on NYAANWORK_WINDOW_SYSTEM_BACKENDS_LINUX

		config NYAANWORK_WINDOW_SYSTEM_BACKENDS_WINDOWS
			bool "MS Windows"
			default y
	endmenu
endmenu
```

## template/Module/Kconfig
```kconfig
config NYAANWORK_Module
	bool "Enable Module module"
	default y

#	depends on NYAANWORK_Module
```

## tests/Kconfig
```kconfig
config NYAANWORK_TESTS
	bool "Enable tests"
	default n

config NYAANWORK_TESTS_CORE
	bool "Core"
	default y
	depends on NYAANWORK_TESTS

config NYAANWORK_TESTS_ASSET
	bool "Asset"
	default y
	depends on NYAANWORK_TESTS && NYAANWORK_ASSET

config NYAANWORK_TESTS_WINDOW_SYSTEM
	bool "WindowSystem"
	default y
	depends on NYAANWORK_TESTS && NYAANWORK_WINDOW_SYSTEM

config NYAANWORK_TESTS_INPUT
	bool "Input"
	default y
	depends on NYAANWORK_TESTS && NYAANWORK_INPUT

config NYAANWORK_TESTS_IMGUI
	bool "ImGUI"
	default y
	depends on NYAANWORK_TESTS && NYAANWORK_IMGUI
```
